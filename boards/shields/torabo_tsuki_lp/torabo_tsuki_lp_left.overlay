#include "torabo_tsuki_lp.dtsi"
#include <input/processors.dtsi>
#include <dt-bindings/zmk/input_transform.h>

/* 
 * ここでは「トラックボールの生データを反転するだけ」に絞る。
 * デッドゾーンやレイヤー判定は keymap 側で行う。
 */
&trackball_listener {
    input-processors = <
        &zip_xy_transform (INPUT_TRANSFORM_X_INVERT | INPUT_TRANSFORM_Y_INVERT)
    >;
};
